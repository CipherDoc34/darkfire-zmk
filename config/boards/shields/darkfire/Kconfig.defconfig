## config/boards/shields/darkfire/Kconfig.defconfig
```kconfig
if SHIELD_DARKFIRE_LEFT

config ZMK_KEYBOARD_NAME
    default "Caldera"

config ZMK_SPLIT_ROLE_CENTRAL
    default y

endif

if SHIELD_DARKFIRE_LEFT || SHIELD_DARKFIRE_RIGHT

config ZMK_SPLIT
    default y

endif
```

## config/boards/shields/darkfire/Kconfig.shield
```kconfig
config SHIELD_DARKFIRE_LEFT
    def_bool $(shields_list_contains, darkfire_left)


config SHIELD_DARKFIRE_RIGHT
    def_bool $(shields_list_contains, darkfire_right)
```
